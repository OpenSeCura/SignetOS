/*
 * Copyright 2026 Google LLC
 *
 * Licensed under the Apache License, Version 2.0 (the "License");
 * you may not use this file except in compliance with the License.
 * You may obtain a copy of the License at
 *
 *     https://www.apache.org/licenses/LICENSE-2.0
 *
 * Unless required by applicable law or agreed to in writing, software
 * distributed under the License is distributed on an "AS IS" BASIS,
 * WITHOUT WARRANTIES OR CONDITIONS OF ANY KIND, either express or implied.
 * See the License for the specific language governing permissions and
 * limitations under the License.
 */

OUTPUT_ARCH("riscv")
ENTRY(_start)

PHDRS
{
    kernel_seg PT_LOAD FLAGS(7);
}

SECTIONS
{
    /* Physical RAM start address in QEMU virt machine (-bios none) */
    . = 0x80000000;
    _kernel_start = .;

    .text : ALIGN(4096) {
        *(.text.boot)
        *(.text.trap)
        *(.text*)
    } :kernel_seg

    .rodata : ALIGN(4096) {
        _rodata_start = .;
        *(.rodata.boot_images)
        *(.rodata*)
        . = ALIGN(16);
        _rodata_end = .;
    } :kernel_seg

    /*
     * __cap_relocs section:
     * Generated by LLD (-Wl,--local-caprelocs=legacy).
     * boot.S iterates over this section to initialize all static capability pointers
     * in the GOT and data sections before any C/C++ code executes.
     */
    __cap_relocs : ALIGN(16) {
        . = ALIGN(16);
        ___cap_relocs_start = .;
        *(__cap_relocs)
        ___cap_relocs_end = .;
        . = ALIGN(16);
    } :kernel_seg

    /*
     * In RISC-V Zcheripurecap (9-bit bounds mantissa):
     *   - [_got_start, _got_end) (~18 KiB < 2^15) requires 2^(15-9) = 64-byte
     *     alignment on _got_start and _got_end for exact cgp bounds.
     *   - [_kernel_start, _got_end) (~188 KiB < 2^18) requires 2^(18-9) =
     *     512-byte alignment on _got_end for exact PCC and stvecc bounds,
     *     guaranteeing zero rounding spillover into .data.
     */
    .got : ALIGN(64) {
        . = ALIGN(64);
        _got_start = .;
        *(.got*)
        . = ALIGN(512);
        _got_end = .;
    } :kernel_seg

    .data : ALIGN(4096) {
        _data_start = .;
        *(.data*)
        . = ALIGN(16);
        _data_end = .;
    } :kernel_seg

    /* Dedicated 64KB boot stack + 16KB initial per-hart kernel entry stack
     * + per-hart M-mode CLINT scratch & S-mode boot handoff tables */
    .bss.stack (NOLOAD) : ALIGN(65536) {
        _kernel_stack_base = .;
        . += 65536;
        . = ALIGN(16);
        _kernel_stack_top = .;
        _boot_ksp_base = .;
        . += 16384;
        . = ALIGN(16);
        _boot_ksp_top = .;
        . = ALIGN(64);
        _m_scratch = .;
        . += 1024;
        _hart_boot_table = .;
        . += 1024;
        _boot_lottery = .;
        . += 16;
    } :kernel_seg

    .bss : ALIGN(4096) {
        _bss_start = .;
        *(.bss*)
        *(COMMON)
        . = ALIGN(16);
        _bss_end = .;
    } :kernel_seg

    . = ALIGN(4096);
    _kernel_end = .;
}
